package.xdc
package.bld
package.xs
libmap.xs
makefile
package/package.bld.xml
package/build.cfg
package/package.xdc.inc
.meta/Config.c.xdt
.meta/Config.h.xdt
.meta/ERPC.Config.c.xdt
.meta/ERPC.cpp.xdt
.meta/ERPC.h.xdt
.meta/ERPC.syscfg.js
.meta/GetLibs.syscfg.js
.meta/Interface.syscfg.js
.meta/Makefile.erpc.xdt
.meta/SecMsg.Config.c.xdt
.meta/SecMsg.Config.h.xdt
.meta/SecMsg.syscfg.js
.meta/erpc.js.xdt
.meta/model.gv.xdt
.meta/rpc.gv.xdt
.meta/rpc.component.js
package/package.cfg.xdc.inc
lib/gcc/m4f/rpc_debug.a
lib/gcc/m4f/rpc_release.a
lib/iar/m4f/rpc_debug.a
lib/iar/m4f/rpc_release.a
lib/iar/m4f/rpc_debug_full.a
lib/iar/m4f/rpc_release_full.a
lib/ticlang/m4f/rpc_debug.a
lib/ticlang/m4f/rpc_release.a
lib/ticlang/m4f/rpc_coverage.a
lib/ccs/m4f/rpc_debug.a
lib/ccs/m4f/rpc_release.a
lib/ccs/m4f/rpc_profile.a
lib/ccs/m4f/rpc_coverage.a
